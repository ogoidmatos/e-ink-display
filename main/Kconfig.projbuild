## main/Kconfig.projbuild
```kconfig
menu "WiFi Configuration"
    config WIFI_SSID
        string "WiFi SSID"
        default "your-ssid"
        help
            The SSID of the WiFi network to connect to.

    config WIFI_PASSWORD
        string "WiFi Password"
        default "your-password"
        help
            The password for the WiFi network.
endmenu

menu "Google API Keys Configuration"
    config GOOGLE_API_KEY
        string "Google API Key"
        default "your-api-key"
        help
            The API key for accessing the Google Maps Weather API.

    config CLIENT_EMAIL
        string "Service Account Client Email"
        default "your-service-account-email"
        help
            The client email of the service account used for calendar access.
endmenu

menu "E-Paper Display App Configuration"
    config USE_DYNAMIC_LOCATION
        bool "Use Dynamic Location"
        default y
        help
            Enable this option to fetch weather data based on the device's current location using IP. If this option is disabled, the static latitude and longitude values below will be used.
    
    config LATITUDE
        string "Latitude"
        default "0.0"
        help
            The latitude of the location for which to fetch weather data.

    config LONGITUDE
        string "Longitude"
        default "0.0"
        help
            The longitude of the location for which to fetch weather data.

    config CALENDAR
        string "Calendar ID"
        default "primary"
        help
            The calendar ID for which to fetch events. Use "primary" for the primary calendar of the authenticated user. Primary calendar might not work with service accounts.

    config UPDATE_INTERVAL
        int "Update Interval (hours)"
        default 6
        help
            The interval in hours at which the app will fetch new weather and calendar data.
endmenu
```
